## Kconfig
```kconfig
# entry of menuconfig
# mainmenu "Phytium FreeRTOS SDK Configuration"

STANDALONE_DIR := $(FREERTOS_STANDALONE)

menu "Standalone Setting"
    config USE_FREERTOS
        bool "Building FreeRTOS Application"
        default y
        help
            Building FreeRTOS Application

    source "$(STANDALONE_DIR)/bsp/arch/Kconfig"
    source "$(STANDALONE_DIR)/bsp/board/Kconfig"
    source "$(STANDALONE_DIR)/bsp/drivers/Kconfig"
    source "$(STANDALONE_DIR)/lib/Kconfig"
endmenu

menu "Building Option"
    source "$(STANDALONE_DIR)/bsp/common/Kconfig"
    source "$(FREERTOS_SDK_ROOT)/make/ld/Kconfig"
endmenu

menu "Component Configuration"  
    source "$(FREERTOS_SDK_ROOT)/drivers/Kconfig"
endmenu

menu "FreeRTOS Setting"
    source "$(FREERTOS_SDK_ROOT)/third-party/Kconfig"
endmenu
```

## configs/d2000_aarch32_defconfig
```kconfig
#
# Project Configuration
#
CONFIG_TARGET_NAME="d2000_freertos"
# end of Project Configuration

#
# Standalone Setting
#
CONFIG_USE_FREERTOS=y

#
# Arch Configuration
#
CONFIG_TARGET_ARMV8_AARCH32=y
# CONFIG_TARGET_ARMV8_AARCH64 is not set
# CONFIG_TARGET_ARMV7 is not set
CONFIG_USE_CACHE=y
CONFIG_USE_L3CACHE=y
CONFIG_USE_MMU=y
# CONFIG_USE_SYS_TICK is not set
CONFIG_USE_AARCH64_L1_TO_AARCH32=y
# end of Arch Configuration

#
# Board Configuration
#
# CONFIG_TARGET_F2000_4 is not set
# CONFIG_TARGET_E2000 is not set
CONFIG_TARGET_D2000=y
# end of Board Configuration

#
# Components Configuration
#
# CONFIG_USE_SPI is not set
# CONFIG_USE_QSPI is not set
CONFIG_USE_GIC=y
CONFIG_EBABLE_GICV3=y
# CONFIG_USE_SERIAL is not set

#
# Usart Configuration
#
CONFIG_ENABLE_Pl011_UART=y
# end of Usart Configuration

# CONFIG_USE_GPIO is not set
# CONFIG_USE_IOMUX is not set
CONFIG_USE_ETH=y

#
# Eth Configuration
#
# CONFIG_ENABLE_F_XMAC is not set
CONFIG_ENABLE_F_GMAC=y

#
# F_GMAC Configuration
#
# CONFIG_F_GMAC_PHY_COMMON is not set
# CONFIG_F_GMAC_PHY_AR803X is not set
# end of F_GMAC Configuration
# end of Eth Configuration

# CONFIG_USE_CAN is not set
# CONFIG_USE_I2C is not set
# CONFIG_USE_TIMER is not set
# CONFIG_USE_SDMMC is not set
# CONFIG_USE_PCIE is not set
# CONFIG_USE_WDT is not set
# CONFIG_USE_DMA is not set
# CONFIG_USE_NAND is not set
# end of Components Configuration

CONFIG_USE_G_LIBC=y
# CONFIG_USE_NEW_LIBC is not set
# end of Standalone Setting

#
# Building Option
#
CONFIG_ENVI_UBUNTU_20_04=y

#
# Cross-Compiler Setting
#
CONFIG_COMPILER_NO_STD_STARUP=y
# CONFIG_USE_EXT_COMPILER is not set
# end of Cross-Compiler Setting

# CONFIG_LOG_VERBOS is not set
# CONFIG_LOG_DEBUG is not set
CONFIG_LOG_INFO=y
# CONFIG_LOG_WARN is not set
# CONFIG_LOG_ERROR is not set
# CONFIG_LOG_NONE is not set

#
# GNU Linker Setting
#
CONFIG_AARCH32_RAM_LD=y
# CONFIG_AARCH64_RAM_LD is not set
# CONFIG_USER_DEFINED_LD is not set
CONFIG_LINK_SCRIPT_ROM=y
CONFIG_ROM_START_UP_ADDR=0x80100000
CONFIG_ROM_SIZE_MB=1
CONFIG_LINK_SCRIPT_RAM=y
CONFIG_RAM_START_UP_ADDR=0x81000000
CONFIG_RAM_SIZE_MB=64
CONFIG_HEAP_SIZE=0x100000
CONFIG_STACK_SIZE=0x100000
# end of GNU Linker Setting
# end of Building Option

#
# Component Configuration
#

#
# Freertos Drivers
#
CONFIG_FREERTOS_USE_UART=y
# end of Freertos Drivers
# end of Component Configuration

#
# FreeRTOS Setting
#
# CONFIG_USE_LWIP=y

#
# LWIP Configuration
#
# CONFIG_LWIP_F_GMAC=y
# end of LWIP Configuration
# end of FreeRTOS Setting
```

## drivers/Kconfig
```kconfig
menu "FreeRTOS Uart Drivers"
    config FREERTOS_USE_UART
        bool
        prompt "Use FreeRTOS uart driver"
        default n
        select USE_SERIAL
        select ENABLE_Pl011_UART
        
    config FREERTOS_USE_SERIAL_V2
        bool
        prompt "Use FreeRTOS serial v2 driver"
        default n
        select USE_SERIAL
        select USE_SERIAL_V2
endmenu

menu "FreeRTOS Pwm Drivers"
    config FREERTOS_USE_PWM
        bool
        prompt "Use FreeRTOS pwm driver"
        default n
        select USE_PWM
        select USE_FPWM
endmenu

menu "FreeRTOS Qspi Drivers"
    config FREERTOS_USE_QSPI
        bool
        prompt "Use FreeRTOS qspi driver"
        default n
        select USE_QSPI
        select USE_FQSPI
endmenu

menu "FreeRTOS Wdt Drivers"
    config FREERTOS_USE_WDT
        bool
        prompt "Use FreeRTOS wdt driver"
        default n
        select USE_WDT
        select USE_FWDT
endmenu

menu "FreeRTOS Eth Drivers"
    config FREERTOS_USE_XMAC
        select ENABLE_FXMAC
        bool
        prompt "Use FreeRTOS xmac driver"
        default n
    
    config FREERTOS_USE_GMAC
        select ENABLE_FGMAC
        bool
        prompt "Use FreeRTOS gmac driver"
        default n

    config FREERTOS_USE_XMAC_V2
        select ENABLE_FXMAC_V2
        bool
        prompt "Use Freertos xmac v2 driver"
        default n        
endmenu

menu "FreeRTOS Spim Drivers"
    config FREERTOS_USE_FSPIM
        bool
        prompt "Use FreeRTOS spim driver"
        default n
        select USE_SPI
        select USE_FSPIM

    config FREERTOS_USE_FSPIM_V2
        bool
        prompt "Use Freertos spim v2 driver"
        default n
        select USE_SPI
        select USE_FSPIM_V2
endmenu

menu "FreeRTOS DMA Drivers"
    config FREERTOS_USE_FDDMA
        bool
        prompt "Use FreeRTOS ddma driver"
        default n

    config FREERTOS_USE_FGDMA
        bool
        prompt "Use FreeRTOS gdma driver"
        default n
endmenu

menu "FreeRTOS Adc Drivers"
    config FREERTOS_USE_ADC
        bool
        prompt "Use FreeRTOS adc driver"
        default n
        select USE_ADC
        select USE_FADC
endmenu

menu "FreeRTOS Can Drivers"
    config FREERTOS_USE_CAN
        bool
        prompt "Use FreeRTOS can driver"
        default n
        select USE_CAN
        select USE_FCAN
endmenu

menu "FreeRTOS I2c Drivers"
    config FREERTOS_USE_I2C
        bool
        prompt "Use FreeRTOS i2c driver"
        default n
    
    config FREERTOS_USE_FI2C_V2
        bool
        prompt "Use Freertos i2c v2 driver"
        default n
        select USE_FI2C_V2
endmenu

menu "FreeRTOS Mio Drivers"
    config FREERTOS_USE_MIO
        bool
        prompt "Use FreeRTOS mio driver"
        default n
endmenu

menu "FreeRTOS Timer Drivers"
    config FREERTOS_USE_TIMER
        bool
        prompt "Use FreeRTOS timer driver"
        default n
endmenu

menu "FreeRTOS Media Drivers"
    config FREERTOS_USE_MEDIA
        bool
        prompt "Use FreeRTOS media driver"
        default n
endmenu

menu "FreeRTOS I2s Drivers"
    config FREERTOS_USE_I2S
        bool
        prompt "Use FreeRTOS i2s driver"
        default n
endmenu
```

## example/ft2004_aarch32_start_up/Kconfig
```kconfig
#
# For a description of the syntax of this configuration file,
# see tools/kconfiglib/kconfig-language.txt.
#

mainmenu "Phytium FreeRTOS SDK Configuration"

	menu "Project Configuration"
		menu "FT2000-4 AARCH32 FreeRTOS Configuration"
		
			config TARGET_NAME
				string "Build Target Name"
				default "ft2004_freertos"
				help
					Build Target name for the demo
			choice TARGET_DEMO_TYPE
				prompt "Choose The Demo"
				default DEMO_MSG_QUEUE
				help
					Choose the FreeRTOS Demo.

				config DEMO_HELLO_WORLD
					bool
					prompt "Hello World"

				config DEMO_GET_CPU_STATS
					bool
					prompt "Show CPU Statistics"

				config DEMO_MSG_QUEUE
					bool
					prompt "Message Queue"	

				config DEMO_SEMAPHORE
					bool
					prompt "Semaphore"	

			endchoice # TARGET_DEMO_TYPE				
		endmenu
	endmenu

source "$(FREERTOS_SDK_ROOT)/Kconfig"
```

## example/ft2004_aarch64_buffer/Kconfig
```kconfig
#
# For a description of the syntax of this configuration file,
# see tools/kconfiglib/kconfig-language.txt.
#

mainmenu "Phytium FreeRTOS SDK Configuration"

menu "Project Configuration"
	menu "FT2000-4 Baremetal Configuration"
	
		config TARGET_NAME
			string "Build Target Name"
			default "ft2004_generic_timer_test"
			help
				Build Target name for the demo
	endmenu
endmenu

source "$(FREERTOS_SDK_ROOT)/Kconfig"
```

## example/function_test/Kconfig
```kconfig
mainmenu "Phytium Baremetal Configuration"

menu "Project Configuration"
	config TARGET_NAME
		string "Build Target Name"
		default "freertos_test"
		help
			Build Target name for the demo
endmenu

source "$(FREERTOS_SDK_ROOT)/Kconfig"
```

## example/hello_world/Kconfig
```kconfig
#
# For a description of the syntax of this configuration file,
# see tools/kconfiglib/kconfig-language.txt.
#

mainmenu "Phytium FreeRTOS SDK Configuration"

	menu "Project Configuration"
		menu "FT2000-4 AARCH32 FreeRTOS Configuration"
		
			config TARGET_NAME
				string "Build Target Name"
				default "ft2004_freertos"
				help
					Build Target name for the demo				
		endmenu
	endmenu
source "$(FREERTOS_SDK_ROOT)/Kconfig"
```

## example/lwip_test/Kconfig
```kconfig
mainmenu "Phytium FreeRTOS Configuration"

	menu "Project Configuration"
	
		config TARGET_NAME
			string "Build Target Name"
			default "baremetal"
			help
				Build Target name for the demo
		
		choice
			prompt "choice lwip config"
			default LWIP_IPV4_TEST
			config LWIP_IPV4_TEST
				bool "test lwip ipv4"
			config LWIP_IPV4_DHCP_TEST
				bool "test lwip ipv4 and dhcp"
			config LWIP_IPV6_TEST
				bool "test lwip ipv6"
		endchoice

		config GMAC_RX_DESCNUM
			int "receive description number"
			default "16"
			help
				receive description number for the demo

		config GMAC_TX_DESCNUM
			int "transmit description number"
			default "16"
			help
				transmit description number for the demo
		
		config GMAC_IRQ_PRIORITY
			int "gmac irq priority, 0~15"
			default "12"
			help
				gmac irq priority for the demo
	endmenu

source "$(FREERTOS_SDK_ROOT)/Kconfig"
```

## example/network/lwip_startup/Kconfig
```kconfig
mainmenu "Phytium FreeRTOS Configuration"

	menu "Project Configuration"
	
		config TARGET_NAME
			string "Build Target Name"
			default "freertos"
			help
				Build Target name for the demo
		
		source "./src/Kconfig"

	endmenu
	
source "$(FREERTOS_SDK_ROOT)/Kconfig"
```

## example/network/lwip_startup/src/Kconfig
```kconfig
menu " Lwip startup test configuration"

    config LWIP_IPV6_TEST
        bool "Enable IPv6"
        select LWIP_IPV6
        default n

    config LWIP_DHCP_TEST
        bool "Enable DHCP"
        select LWIP_DHCP_ENABLE
        default n

if TARGET_E2000
    choice EVALUATION_BOARD_TYPE
        prompt "Select evaluation board"
        default BOARD_TYPE_B
        help
            Select board type for build
        config BOARD_TYPE_B
            bool "evaluation board b"
        config BOARD_TYPE_C
            bool "evaluation board c"
        config BOARD_TYPE_A
            bool "evaluation board a"
        config BOARD_TYPE_DEMO
            bool "evaluation board demo"
        endchoice # BUILD_TARGET_ARCH_TYPE
endif

endmenu
```

## example/network/sockets/udp_multicast/Kconfig
```kconfig
mainmenu "Phytium FreeRTOS Configuration"

	menu "Project Configuration"
	
		config TARGET_NAME
			string "Build Target Name"
			default "freertos"
			help
				Build Target name for the demo
		

		if TARGET_E2000
			source "./src/Kconfig"
		endif
		
	endmenu
	
source "$(FREERTOS_SDK_ROOT)/Kconfig"
```

## example/network/xmac_lwip_test/Kconfig
```kconfig
mainmenu "Phytium FreeRTOS Configuration"

	menu "Project Configuration"
	
		config TARGET_NAME
			string "Build Target Name"
			default "freertos"
			help
				Build Target name for the demo
		
		choice
			prompt "choice lwip config"
			default LWIP_IPV4_TEST
			config LWIP_IPV4_TEST
				bool "test lwip ipv4"
			config LWIP_IPV4_DHCP_TEST
				bool "test lwip ipv4 and dhcp"
			config LWIP_IPV6_TEST
				bool "test lwip ipv6"
		endchoice

		config GMAC_RX_DESCNUM
			int "receive description number"
			default "16"
			help
				receive description number for the demo

		config GMAC_TX_DESCNUM
			int "transmit description number"
			default "16"
			help
				transmit description number for the demo
		
		config GMAC_IRQ_PRIORITY
			int "gmac irq priority, 0~15"
			default "12"
			help
				gmac irq priority for the demo

		if TARGET_E2000
			source "./src/Kconfig"
		endif
		
	endmenu
	
source "$(FREERTOS_SDK_ROOT)/Kconfig"
```

## example/network/xmac_lwip_test/src/Kconfig
```kconfig
menu " E2000 board Configuration"

    choice EXAMPLE_IP_MODE
        prompt "choice lwip config"
        help
            Example can multicast IPV4, IPV6, or both.

        default LWIP_IPV4_TEST
        config LWIP_IPV4_TEST
            bool "test lwip ipv4" 
        config LWIP_IPV4_DHCP_TEST
            bool "test lwip ipv4 and dhcp"
        config LWIP_IPV6_TEST
            bool "test lwip ipv6"
    endchoice

    config LWIP_IPV4_TEST
        bool
        select LWIP_ICMP
        select USE_IPV4_ONLY
        select LWIP_NETIF_DEBUG

    config LWIP_IPV4_DHCP_TEST
        bool
        select LWIP_DHCP_ENABLE
        select LWIP_ICMP
        select USE_IPV4_ONLY
        select LWIP_NETIF_DEBUG
        # select LWIP_DHCP_DEBUG

    config LWIP_IPV6_TEST
        bool
        select LWIP_IPV6
        select LWIP_NETIF_DEBUG


    config TARGET_NAME
        string "Build Target Name"
        default "eth test"
        help
            Build Target name for the demo

    choice EVALUATION_BOARD_TYPE
        prompt "Select evaluation board"
        default BOARD_TYPE_B
        help
            Select board type for build
        config BOARD_TYPE_B
            bool "evaluation board b"
        config BOARD_TYPE_C
            bool "evaluation board c"
        config BOARD_TYPE_A
            bool "evaluation board a"
        config BOARD_TYPE_DEMO
            bool "evaluation board demo"
        endchoice # BUILD_TARGET_ARCH_TYPE

endmenu
```

## example/storage/fatfs/Kconfig
```kconfig
mainmenu "Phytium Baremetal Configuration"

menu "Project Configuration"
	
	config TARGET_NAME
		string "Build Target Name"
		default "template"
		help
			Build Target name for the demo

	config FATFS_BASIC_TEST
		bool "Basic Test"
		default y

	config FATFS_SPEED_TEST
		bool "Speed Test"
		default n

	config FATFS_CYCLE_TEST
		bool "Cycle Test"
		default n

endmenu

source "$(FREERTOS_SDK_ROOT)/Kconfig"
```

## example/system/amp/openamp_for_linux/Kconfig
```kconfig
#
# For a description of the syntax of this configuration file,
# see tools/kconfiglib/kconfig-language.txt.
#


mainmenu "Phytium FreeRTOS Configuration"

	menu "Project Configuration"

		menu " FreeRTOS Configuration"
		config TARGET_NAME
			string "Build Target Name"
			default "openamp_for_linux"
			help
				Build Target name for the demo

	endmenu

endmenu

source "$(SDK_DIR)/../freertos.kconfig"
```

## example/system/atomic/Kconfig
```kconfig
mainmenu "Phytium Baremetal Configuration"

mainmenu "Phytium Freertos Configuration"

	menu "Freertos Configuration"
	config TARGET_NAME
		string "Build Target Name"
		default "freertos"
		help
			Build Target name for the demo
	
endmenu

source "$(FREERTOS_SDK_ROOT)/Kconfig"
```

## example/template/Kconfig
```kconfig
mainmenu "Phytium Baremetal Configuration"

menu "Project Configuration"
	
	config TARGET_NAME
		string "Build Target Name"
		default "template"
		help
			Build Target name for the demo
			
endmenu

source "$(FREERTOS_SDK_ROOT)/Kconfig"
```

## make/Kconfig
```kconfig
menu  "Compiler Options"


menu "Cross-Compiler Setting"

    config GCC_OPTIMIZE_LEVEL
        int "Set Optimize Level"
        default 0
        help 
            Set Optimize level for GCC

    config USE_EXT_COMPILER
        bool "Use User-Specified Compiler"
        default n

    config USE_KLIN_SYS
        bool "Use Klin system"
        default n

    config EXT_COMPILER_PREFIX
        depends on USE_EXT_COMPILER
        string ""
        default "arm-none-eabi-" if TARGET_ARMV8_AARCH32
        default "aarch64-none-elf-" if TARGET_ARMV8_AARCH64 
endmenu

config OUTPUT_BINARY
    bool "Build *.bin as Ouput"
        default n
        help
            Build binary files *.bin as Outputs 

endmenu
```
