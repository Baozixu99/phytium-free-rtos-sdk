## make/ld/Kconfig
```kconfig
# entry of menuconfig

menu  "Linker Options"
    choice 
        prompt "Select Linker Script Template"
        optional

        config AARCH32_RAM_LD
            bool "Use aarch32_ram.ld"
            help
                Use linkscript for booting AARCH32 Baremetal Image from DDR

        config AARCH64_RAM_LD
            bool "Use aarch64_ram.ld"
            help
                Use linkscript for booting AARCH64 Baremetal Image from DDR  

        config USER_DEFINED_LD
            bool "Other link script"
            help
                Use other link script provided by User

    endchoice
    
    config LINK_SCRIPT_ROM
        bool "Allocate ROM"
        default y
        help
            Allocate ROM for link scripts

    if LINK_SCRIPT_ROM
        config ROM_START_UP_ADDR
            hex "ROM Start up Address"
            default "0x80100000"
            help
                Assign Start up Address for ROM in Linkscript

        config ROM_SIZE_MB
            int "ROM Size (MB)"
            default "1"
            help
                Assign ROM size for Master Core in Linkscript        
    endif

    config LINK_SCRIPT_RAM
        bool "Allocate RAM"
        default y
        help
            Allocate RAM for link scripts  

    if LINK_SCRIPT_RAM
        config RAM_START_UP_ADDR
            hex "RAM Start up Address"
            default "0x81000000"
            help
                Assign Start up Address for RAM in Linkscript

        config RAM_SIZE_MB
            int "RAM Size (MB)"
            default "64"
            help
                Assign RAM size in Linkscript            
    endif

    config HEAP_SIZE
        int "Heap Size (MB)"
        default "1"
        help
            Assign Heap size in Linkscript

    config STACK_SIZE
        hex "Stack Size (Byte)"
        default "0x100000"
        depends on AARCH64_RAM_LD
        help
            Assign Stack size in Linkscript  


    config SVC_STACK_SIZE
        hex "Aarch32 supervisor stack size (Byte)"
        default "0x1000"
        depends on AARCH32_RAM_LD
        help
            Assign Stack size in Linkscript  

    config SYS_STACK_SIZE
        hex "Aarch32 system stack size (Byte)"
        default "0x1000"
        depends on AARCH32_RAM_LD
        help
            Assign system stack size in Linkscript  
    
    config IRQ_STACK_SIZE
        hex "Aarch32 Irq stack size (Byte)"
        default "0x1000"
        depends on AARCH32_RAM_LD
        help
            Assign Irq stack size in Linkscript  
    
    config ABORT_STACK_SIZE
        hex "Aarch32 abort stack size (Byte)"
        default "0x1000"
        depends on AARCH32_RAM_LD
        help
            Assign abort stack size in Linkscript  

    config FIQ_STACK_SIZE
        hex "Aarch32 fiq stack size (Byte)"
        default "0x1000"
        depends on AARCH32_RAM_LD
        help
            Assign abort stack size in Linkscript  
    
    config UNDEF_STACK_SIZE
        hex "Aarch32 undef stack size (Byte)"
        default "0x1000"
        depends on AARCH32_RAM_LD
        help
            Assign undef stack size in Linkscript 

    config FPU_STACK_SIZE
        hex "Fpu stack Size (Byte)"
        default "0x1000"
        depends on AARCH64_RAM_LD
        help
            Assign Fpu stack size in Linkscript

endmenu
```

## standalone/drivers/device/Kconfig
```kconfig
menu "DEVICE Configuration"
    config USE_FDEVICE
        bool
        prompt "Use FDEVICE"
        default n

    if USE_FDEVICE
        config USE_FES8336
        bool
        prompt "Use FES8336"
        default n

        config USE_FES8388
        bool
        prompt "Use FES8388"
        default n
        bool

    endif
endmenu
```

## standalone/drivers/eth/Kconfig
```kconfig
menu "Eth Configuration"
    config ENABLE_FXMAC
        bool
        prompt "Use FXMAC"
        default n
    
    config ENABLE_FGMAC
        bool
        prompt "Use FGMAC"
        default n

    config ENABLE_FXMAC_V2
        bool
        prompt "Use FXMAC_V2"
        depends on USE_MSG
        default n 

    config ENABLE_E1000E
        bool
        prompt "Use E1000E"
        default n

    if  ENABLE_FGMAC
        source "$(STANDALONE_DIR)/drivers/eth/fgmac/Kconfig"
    endif

    if  ENABLE_FXMAC
        source "$(STANDALONE_DIR)/drivers/eth/fxmac/Kconfig"
    endif
    
endmenu
```

## standalone/drivers/i2c/Kconfig
```kconfig
config USE_FI2C
    bool
    prompt "Use FI2C"
    default n
    help
        Include FI2C driver component
config USE_FI2C_V2
        bool
        prompt "USE FI2C_V2"
        default n	
    help
        Include FI2C USE_FI2C_v2 driver component	
```

## standalone/drivers/i2s/Kconfig
```kconfig
menu "I2S Configuration"
    config USE_ES8336
        bool
        prompt "USE ES8336"
        depends on  TARGET_PE2202 || TARGET_PE2204 
        default n
    
    config USE_ES8388
        bool
        prompt "USE ES8388"
        depends on  TARGET_PD2308
        default n

    config USE_FI2S
        bool
        prompt "USE FI2S"
        default n

        config USE_FI2S_V2
        bool
        prompt "USE FI2S V2"
        default n

    config USE_CODEC_V2
        bool
        prompt "USE CODEC V2"
        default n
endmenu
```

## standalone/drivers/i3c/Kconfig
```kconfig
config USE_FI3C
    bool
    prompt "Use FI3C"
    default n
    help
        Include FI3C driver component
	
	
```

## standalone/drivers/iomux/Kconfig
```kconfig
config ENABLE_IOCTRL
    bool
    default y if TARGET_PD1904 || TARGET_PD2008
    prompt "Enable ioctrl"

config ENABLE_IOPAD
    bool
    default y if TARGET_PE2204 || TARGET_PE2202 || TARGET_PE2201 
    prompt "Enable iopad"
```
