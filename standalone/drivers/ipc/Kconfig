## standalone/drivers/ipc/Kconfig
```kconfig
config ENABLE_FSEMAPHORE
    bool
    prompt "Use FSemaphore"
    default n
    depends on TARGET_PE2201 || TARGET_PE2202 || TARGET_PE2204 
    help
        Select FSemaphore driver component
	
	
```

## standalone/drivers/media/Kconfig
```kconfig
config USE_FMEDIA_V1
    bool "Use FMEDIA_V1"
    select FMEDIA_CORE  
    help
        Include FMEDIA_V1 driver component

config USE_FMEDIA_V2
    bool "Use FMEDIA_V2"
    select FMEDIA_CORE  
    help
        Include FMEDIA_V2 driver component
```

## standalone/drivers/mio/Kconfig
```kconfig
menu "Hardware Mio Configuration"
    config ENABLE_MIO
        bool
        prompt "Use Mio"
        depends on TARGET_PE220X 

        default n
endmenu
```

## standalone/drivers/mmc/Kconfig
```kconfig
config ENABLE_FSDMMC
    bool
    prompt "Use FSdmmc"
    default n
    depends on USE_SDMMC
    help
        Select FSdmmc driver component
	
config ENABLE_FSDIF
    bool
    prompt "Use FSdif"
    default n
    depends on USE_SDMMC
    help
        Select FSdif driver component

config ENABLE_FSDIF_V2
    bool
    prompt "Use FSdif(v2)"
    default n
    depends on USE_SDMMC
    help
        Select FSdif driver v2 component
```

## standalone/drivers/sec/Kconfig
```kconfig
menu "SEC Configuration"
config ENABLE_FRND
        bool
        prompt "Use FRND"
        default n

config ENABLE_FSHA
        bool
        prompt "Use FSHA"
        default n
endmenu
```

## standalone/drivers/serial/Kconfig
```kconfig
menu "Usart Configuration"
    config ENABLE_Pl011_UART
        bool
        prompt "Use Pl011 uart"
        default y
    config USE_SERIAL_V2
        bool
        prompt "USE SERIAL_V2"
        depends on TARGET_PD2408
        default n	
    help
        Include SERIAL_V2 driver component
endmenu
```

## standalone/drivers/spi/Kconfig
```kconfig
config USE_FSPIM
    bool
    prompt "Use FSPIM"
    default n
    depends on USE_SPI
    help
        Select FSPIM driver component

config USE_FSPIM_V2
    bool
    prompt "Use FSPIM_V2"
    default n
    depends on USE_SPI
    help
        Select FSPIM_V2 driver component
	
	
```

## standalone/drivers/timer/Kconfig
```kconfig
menu "Hardware Timer Configuration"
    config ENABLE_TIMER_TACHO
        bool
        prompt "Use Timer Tacho"

        default n
endmenu
```

## standalone/third-party/lwip-2.1.2/ports/Kconfig
```kconfig
menu "LWIP Port Configuration"

    config LWIP_FXMAC
        select FREERTOS_USE_XMAC
        bool "FXMAC"

    config LWIP_FXMAC_V2
        select FREERTOS_USE_XMAC_V2
        bool "FXMAC_V2"            
        depends on USE_MSG  
    
    config LWIP_FGMAC
        select FREERTOS_USE_GMAC
        bool "FGMAC"

    config LWIP_E1000E
        select FREERTOS_USE_E1000E
        bool "E1000E"            

    config LWIP_FSDIF
        bool "FSDIF"
        
endmenu
```

## standalone/third-party/openamp/ports/Kconfig
```kconfig
menu "OpenAmp"

    config USE_OPENAMP
        bool "OpenAMP Support"
        select USE_LIBMETAL
        help
            This option enables the OpenAMP library
        if USE_OPENAMP
            config USE_OPENAMP_IPI
                bool "Remoteproc use ipi"
                help
                    This configuration enables IPI working mode in OpenAMP mode
            
            config SKIP_SHBUF_IO_WRITE
                bool 
                prompt "Skip local rvdev->shbuf_io"
                help
                    rpmsg_virtio_send_offchannel_raw skip rvdev->shbuf_io metal_io_block_write
                default n
            
            config USE_MASTER_VRING_DEFINE
                bool
                prompt "Use the Vring definition in the master"
                default n

            config USE_CACHE_COHERENCY
                bool
                prompt "Use cache coherency"
                default n
        endif

endmenu
```

## standalone/third-party/spiffs-0.3.7/Kconfig
```kconfig
menu "Spiffs configuration"

config SPIFFS_ON_FSPIM_SFUD
    bool
    prompt "Use fspim(sfud)"        
    select USE_SPI
    select USE_FSPIM
    select SFUD_CTRL_FSPIM
    default n

config SPIFFS_ON_FSPIM_V2_SFUD
    bool
    prompt "Use fspim_v2(sfud)"        
    select USE_SPI
    select USE_FSPIM_V2
    select SFUD_CTRL_FSPIM_V2
    default n

config SPIFFS_ON_FQSPI_SFUD
    bool
    prompt "Use FQSPI(sfud)"        
    select USE_QSPI
    select USE_FQSPI
    select SFUD_CTRL_FQSPI
    default n

endmenu
```

## third-party/Kconfig
```kconfig
config USE_LWIP
    bool
    prompt "Use LWIP"
    select USE_SYS_TICK
    help
        Include LWIP for Network Protocol

    if USE_LWIP
        source "$(FREERTOS_SDK_ROOT)/third-party/lwip-2.1.2/Kconfig"
    endif


config USE_BACKTRACE
    bool
    prompt "Display a backtrace."
    default y



config USE_AMP
    bool
    prompt "Use Asymmetric Multi-processing"
    default n
    help
        Include OpenAMP framework

    if USE_AMP
        config USE_LIBMETAL
            bool
            prompt "Use Libmetal"
            help
                Include Libmetal

        source "$(FREERTOS_SDK_ROOT)/third-party/openamp/ports/Kconfig"

    endif


config USE_LETTER_SHELL
    bool
    prompt "Use Letter Shell"
    default n
    help
        Include Litter Shell for User Interactive

    if USE_LETTER_SHELL
        source "$(FREERTOS_SDK_ROOT)/third-party/letter-shell-3.1/Kconfig"
    endif
```

## third-party/fatfs-0.1.3/Kconfig
```kconfig
menu "FATFS Configuration"
    choice FATFS_DISK_TYPE
        prompt "Select Fatfs Disk Type"
        default SELECT_FATFS_RAM_DISK
        help
            Select Disk Type for FATFS

        config SELECT_FATFS_RAM_DISK
            bool "Ram Disk"

        config SELECT_FATFS_FSDMMC
            bool "Sd Card(FSdmmc)"
            select USE_SDMMC_CMD

        config SELECT_FATFS_FSATA_PCIE
            bool "Sata_Pcie"
            select USE_PCIE
            select ENABLE_F_PCIE
            select USE_SATA
            select ENABLE_FSATA
        
        config SELECT_FATFS_FSATA_CONTROLLER
            depends on TARGET_E2000
            bool "Sata_Controller"
            select USE_SATA
            select ENABLE_FSATA

        config SELECT_FATFS_USB
            bool "Usb Disk"
            select USE_USB
            select ENABLE_USB_FXHCI

    endchoice # LETTER_SHELL_USART_TYPE
endmenu
```

## third-party/letter-shell-3.1/Kconfig
```kconfig
menu "Letter Shell Configuration"
    choice LETTER_SHELL_USART_TYPE
        prompt "Usart Drivers"
        default LS_PL011_UART
        help
            Select Usart Driver for Letter Shell

        config LS_PL011_UART
            select FREERTOS_USE_UART
            bool "PL011"

        config LS_SERIAL_V2
            select FREERTOS_USE_SERIAL_V2
            depends on TARGET_PD2408
            bool "Serial V2"

        choice LETTER_SHELL_USE_UART_INSTANCE
            prompt "Select Debug uart instance"
            default DEFAULT_LETTER_SHELL_USE_UART1
            help
                Select arch for build
            config DEFAULT_LETTER_SHELL_USE_UART1
                bool "Use uart1"
            config DEFAULT_LETTER_SHELL_USE_UART0
                bool "Use uart0"
            config DEFAULT_LETTER_SHELL_USE_UART2
                bool "Use uart2"
            endchoice # SHELL_USE_UART

    endchoice # LETTER_SHELL_USART_TYPE

    choice
        prompt "Uart Mode"
        default LETTER_SHELL_UART_INTERRUPT_MODE

    config LETTER_SHELL_UART_INTERRUPT_MODE
        bool "Interrupt Mode"
        help
            "Use the interrupt mode for letter shell."

    config LETTER_SHELL_UART_POLLED_MODE
        bool "Polled Mode"
        help
            "Use the polled mode for letter shell ."

    config LETTER_SHELL_UART_MSG_INTR_MODE
        bool "Msg Intr Mode"
        depends on TARGET_PD2408
        help
            "Use Msg Intr mode for letter shell."

    config LETTER_SHELL_UART_MSG_POLLED_MODE
        bool "Msg Polled Mode"
        depends on TARGET_PD2408
        help
            "Use Msg polled mode for letter shell."
    endchoice
    
endmenu
```

## third-party/lwip-2.1.2/Kconfig
```kconfig
menu "LWIP Configuration"
    choice LWIP_GMAC_CTRL_TYPE
        prompt "Gmac Drivers"
        default LWIP_FGMAC
        help
            Select Gmac Driver for Lwip

        config LWIP_FGMAC
            select USE_ETH
            select ENABLE_FGMAC
            bool "FGMAC"

        config LWIP_FXMAC
            select USE_ETH
            select ENABLE_FXMAC
            bool "FXMAC"

    endchoice # LWIP_GMAC_CTRL_TYPE
endmenu
```

## third-party/lwip-2.1.2/ports/Kconfig
```kconfig
menu "LWIP Port Configuration"

    choice LWIP_GMAC_CTRL_TYPE
        prompt "Gmac Drivers"
        default LWIP_FGMAC
        help
            Select Gmac Driver for Lwip

        config LWIP_FGMAC
            bool "FGMAC"

        config LWIP_FXMAC
            select FREERTOS_USE_XMAC
            bool "FXMAC"

    endchoice # LWIP_GMAC_CTRL_TYPE

    # add thread configuration

    

endmenu
```
